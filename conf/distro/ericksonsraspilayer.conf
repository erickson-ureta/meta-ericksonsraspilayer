## conf/distro/ericksonsraspilayer.conf
```bitbake
DISTRO_NAME = "ericksonsraspilayer"
DISTRO_VERSION = "0.0.1"

MAINTAINER = "Erickson Ureta <erick.ureta95@gmail.com>"

# Force empty to avoid messing with the build/tmp dir
TCLIBCAPPEND = ""

# meta-raspberrypi specific settings
ENABLE_UART = "1"
RPI_USE_U_BOOT = "1"
LICENSE_FLAGS_ACCEPTED:append = " synaptics-killswitch"

# Allow ffmpeg to be built
LICENSE_FLAGS_ACCEPTED:append = " commercial"

# Avoid dependencies on meta-multimedia,
# as per the README found on meta-openembedded/meta-xfce
BBMASK = "meta-xfce/recipes-multimedia"
DISTRO_FEATURES:append = " opengl"

# Wifi support
DISTRO_FEATURES:append = " bluez5"

# Enable and use systemd as the default init manager
DISTRO_FEATURES:append = " systemd"
VIRTUAL-RUNTIME_init_manager = "systemd"
VIRTUAL-RUNTIME_initscripts = "systemd-compat-units"
DISTRO_FEATURES:append = " usrmerge"

# SSH server support
IMAGE_FEATURES:append = " ssh-server-openssh"

# RAUC support
WKS_FILE = "erickson-raspi-sdimage-dual.wks.in"
DISTRO_FEATURES:append = " rauc"
INIT_MANAGER = "systemd"
```

## conf/layer.conf
```bitbake
# We have a conf and classes directory, add to BBPATH
BBPATH .= ":${LAYERDIR}"

# We have recipes-* directories, add to BBFILES
BBFILES += "${LAYERDIR}/recipes-*/*/*.bb \
            ${LAYERDIR}/recipes-*/*/*.bbappend"

BBFILE_COLLECTIONS += "meta-ericksonsraspilayer"
BBFILE_PATTERN_meta-ericksonsraspilayer = "^${LAYERDIR}/"
BBFILE_PRIORITY_meta-ericksonsraspilayer = "6"

LAYERDEPENDS_meta-ericksonsraspilayer = "core"
LAYERSERIES_COMPAT_meta-ericksonsraspilayer = "scarthgap"
```
